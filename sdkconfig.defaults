## sdkconfig.defaults
```kconfig
# Target
CONFIG_IDF_TARGET="esp32s3"

# CPU frequency
CONFIG_ESP32S3_DEFAULT_CPU_FREQ_240=y

# PSRAM (Octal, 8 MB)
CONFIG_ESP32S3_SPIRAM_SUPPORT=y
CONFIG_SPIRAM_MODE_OCT=y
CONFIG_SPIRAM_SPEED_80M=y
CONFIG_SPIRAM_MALLOC_ALWAYSINTERNAL=4096

# Disable WiFi
# CONFIG_ESP_WIFI_ENABLED is not set

# Disable Bluetooth
# CONFIG_BT_ENABLED is not set

# Logging — error level only (use menuconfig to re-enable INFO during development)
CONFIG_LOG_DEFAULT_LEVEL_ERROR=y
CONFIG_LOG_DEFAULT_LEVEL=1

# FatFS — enable long filename support for SD card
CONFIG_FATFS_LFN_HEAP=y
CONFIG_FATFS_MAX_LFN=255

# Power management — enable tickless idle
CONFIG_PM_ENABLE=y
CONFIG_FREERTOS_USE_TICKLESS_IDLE=y
```
